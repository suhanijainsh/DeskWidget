#include <WiFi.h>
#include <HTTPClient.h>
#include <ArduinoJson.h>
#include <Wire.h>
#include <Adafruit_GFX.h>
#include <Adafruit_SH110X.h>
#include <WiFiClientSecure.h>
#include <WiFiManager.h>


// -------- DISPLAY --------
Adafruit_SH1106G display(128, 64, &Wire);

// -------- TOUCH --------
#define TOUCH_PIN 7
#define WHITE SH110X_WHITE

// -------- LOCATION --------
float userLat = 12.9683488;
float userLon = 77.6448873;
float flightAlt = 0;

int planeX = -32;
unsigned long lastPlaneMove = 0;
// -------- MODES --------
bool flightMode = false;
int currentImage = 0;
bool isFetching = false; 

// -------- TOUCH STATE --------
unsigned long pressStart = 0;
bool lastTouch = LOW;

// -------- FLIGHT --------
struct Flight {
  String name;
  float distance;
  float alt;
};

Flight flights[3];
int flightCount = 0;       // how many valid flights we actually got
int currentFlight = 0; 
String flightName = "N/A";
float flightDistance = 0;

// -------- TIMING --------
unsigned long lastFetch = 0;
unsigned long lastDraw = 0;


// -------- YOUR BITMAPS (UNCHANGED) --------
// KEEP your img1, img2, img3 exactly as you already have them
const unsigned char img1[] PROGMEM = {
  0xff, 0xff, 0xff, 0xff, 0xff, 0xff, 0xe0, 0x0f, 0xff, 0xff, 0xff, 0xff, 0xff, 0xff, 0xff, 0xff, 
  0xff, 0xff, 0xff, 0xff, 0xff, 0xff, 0xc0, 0x07, 0xff, 0xff, 0xff, 0xff, 0xff, 0xff, 0xff, 0xff, 
  0xff, 0xff, 0xff, 0xff, 0xff, 0xfe, 0x00, 0x00, 0xff, 0xff, 0xff, 0xff, 0xff, 0xff, 0xff, 0xff, 
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  0xff, 0xf8, 0x00, 0x00, 0x00, 0x3f, 0xfc, 0x00, 0x00, 0x00, 0x00, 0x00, 0x00, 0x00, 0x0f, 0xfc};
const unsigned char img2[] PROGMEM = {
  0xff, 0xff, 0xff, 0xff, 0xff, 0xff, 0xff, 0xff, 0xff, 0xff, 0xff, 0xff, 0xff, 0xff, 0xff, 0xff, 
	0xff, 0xff, 0xff, 0xff, 0xff, 0xff, 0xff, 0xff, 0xff, 0xff, 0xff, 0xff, 0xff, 0xff, 0xff, 0xff, 
	0xff, 0xff, 0xff, 0xff, 0xff, 0xff, 0xff, 0xff, 0xff, 0xff, 0xff, 0xff, 0xff, 0xff, 0xff, 0xff, 
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	0xff, 0xff, 0xff, 0x80, 0x00, 0x00, 0x00, 0x00, 0x00, 0x00, 0x00, 0x00, 0x00, 0x00, 0x3f, 0xef};
const unsigned char img3[] PROGMEM = {
  0xff, 0xff, 0xff, 0xff, 0xff, 0xff, 0xff, 0xff, 0xff, 0xff, 0xff, 0xff, 0xff, 0xff, 0xff, 0xff, 
	0xff, 0xff, 0xff, 0xff, 0xff, 0xff, 0xff, 0xff, 0xff, 0xff, 0xff, 0xff, 0xff, 0xff, 0xff, 0xff, 
	0xff, 0xff, 0xff, 0xff, 0xff, 0xff, 0xff, 0xff, 0xff, 0xff, 0xff, 0xff, 0xff, 0xff, 0xff, 0xff, 
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	0xff, 0xff, 0xff, 0xff, 0xf0, 0x00, 0x00, 0x00, 0x00, 0x00, 0x00, 0x00, 0x03, 0xff, 0xff, 0xff};
const unsigned char img4[] PROGMEM = {
  0xff, 0xff, 0xff, 0xff, 0xff, 0xff, 0xff, 0xff, 0xff, 0xff, 0xff, 0xff, 0xff, 0xff, 0xff, 0xff, 
	0xff, 0xff, 0xff, 0xff, 0xff, 0xff, 0xff, 0xff, 0xff, 0xff, 0xff, 0xff, 0xff, 0xff, 0xff, 0xff, 
	0xff, 0xff, 0xff, 0xff, 0xff, 0xff, 0xff, 0xff, 0xff, 0xff, 0xff, 0xff, 0xff, 0xff, 0xff, 0xff, 
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	0xff, 0xff, 0xff, 0xfc, 0x00, 0x00, 0x00, 0x00, 0x00, 0x3f, 0x80, 0x00, 0x00, 0x00, 0x1f, 0xff};
const unsigned char img5[] PROGMEM = {
  0xff, 0xff, 0xff, 0xff, 0xef, 0xff, 0xc7, 0x48, 0xc7, 0x82, 0xe7, 0xfb, 0xfc, 0x3f, 0xff, 0xff, 
	0xff, 0xff, 0xff, 0xbf, 0xf7, 0xff, 0x9c, 0x8a, 0x0b, 0xbf, 0xf1, 0xff, 0xff, 0xff, 0xff, 0xff, 
	0xff, 0xff, 0xff, 0xdd, 0xfb, 0x03, 0x3c, 0x16, 0x47, 0xe3, 0xff, 0xff, 0xff, 0xff, 0xff, 0xff, 
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	0xff, 0xff, 0xff, 0xfc, 0x02, 0x00, 0x00, 0x00, 0x00, 0x00, 0x00, 0x07, 0xff, 0xff, 0xff, 0xff};
const unsigned char img6[] PROGMEM = {
  0x00, 0x00, 0x00, 0x00, 0x00, 0x00, 0x00, 0x00, 0x00, 0x1f, 0xff, 0xf0, 0x08, 0xe3, 0xff, 0xff, 
	0x00, 0x00, 0x00, 0x00, 0x00, 0x00, 0x00, 0x00, 0x00, 0x0f, 0xff, 0xf0, 0x04, 0x63, 0xff, 0xff, 
	0x00, 0x00, 0x00, 0x00, 0x00, 0x00, 0x00, 0x00, 0x00, 0x0f, 0xff, 0xf8, 0x04, 0x71, 0xff, 0xe0, 
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	0x00, 0x00, 0x00, 0x73, 0xfe, 0xdf, 0xe0, 0x00, 0x03, 0xff, 0xff, 0xff, 0xff, 0xc7, 0xfe, 0x1f};


const unsigned char* images[] = {img1, img2, img3,img4,img5,img6};

// -------- DISTANCE --------
float getDistance(float lat1, float lon1, float lat2, float lon2) {
  float R = 6371;
  float dLat = (lat2 - lat1) * PI / 180;
  float dLon = (lon2 - lon1) * PI / 180;

  float a = sin(dLat/2)*sin(dLat/2) +
            cos(lat1*PI/180)*cos(lat2*PI/180)*
            sin(dLon/2)*sin(dLon/2);

  float c = 2 * atan2(sqrt(a), sqrt(1-a));
  return R * c;
}


// -------- SETUP --------
WiFiManager wm;
bool wifiConnected = false;

void setup() {
  Serial.begin(115200);
  // wm.resetSettings();


  pinMode(TOUCH_PIN, INPUT);

  Wire.begin(8, 9);

  display.begin(0x3C, true);
  display.setTextColor(SH110X_WHITE);
  display.clearDisplay();
  display.setCursor(0,0);
  display.print("Starting...");
  display.display();

  // ---------------- WIFI MANAGER ----------------
  bool connected = wm.autoConnect("ESP32-Setup");

  wifiConnected = connected;


  if (!connected) {
    Serial.println("WiFi failed, restarting...");
    ESP.restart();
  }

  Serial.println("WiFi Connected!");

  display.clearDisplay();
  display.setCursor(0,0);
  display.print("WiFi OK");
  display.display();

  delay(1000);

  fetchFlight();
}

// -------- LOOP --------
void loop() {
  handleTouch();

  // refresh screen every 200ms (IMPORTANT)
  if (millis() - lastDraw > 800) {
    lastDraw = millis();

    if (flightMode) {
      drawFlight();
    } else {
      drawImage();
    }
  }

  // fetch flight every 60s
  if (flightMode && millis() - lastFetch > 60000) {
    lastFetch = millis();
    fetchFlight();
  }
}

// -------- TOUCH --------
// void handleTouch() {
//   // 🔁 CHANGE THIS LINE if needed:
//   bool touch = digitalRead(TOUCH_PIN);

//   // If your sensor behaves opposite, use this instead:
//   // bool touch = !digitalRead(TOUCH_PIN);

//   if (touch && !lastTouch) {
//     pressStart = millis();
//   }

//   if (!touch && lastTouch) {
//     unsigned long duration = millis() - pressStart;

//     if (duration > 500) {
//       // LONG PRESS → toggle mode
//       flightMode = !flightMode;
//     } else {
//       // SHORT TAP → change image
//       if (!flightMode) {
//         currentImage = (currentImage + 1) % 6;
//       }
//     }
//   }

//   lastTouch = touch;
// }

void handleTouch() {
  bool touch = digitalRead(TOUCH_PIN);

  if (touch && !lastTouch) {
    pressStart = millis();
  }

  if (!touch && lastTouch) {
    unsigned long duration = millis() - pressStart;

    if (duration > 500) {
      // LONG PRESS → toggle mode
      flightMode = !flightMode;
      currentFlight = 0;
      if (flightMode) {
        flightName     = flights[0].name;
        flightDistance = flights[0].distance;
        flightAlt      = flights[0].alt;
      }
    } else {
      if (!flightMode) {
        // IMAGE MODE → cycle images
        currentImage = (currentImage + 1) % 6;
      } else {
        // FLIGHT MODE → cycle through 3 flights
        if (flightCount > 0) {
          currentFlight  = (currentFlight + 1) % flightCount;
          flightName     = flights[currentFlight].name;
          flightDistance = flights[currentFlight].distance;
          flightAlt      = flights[currentFlight].alt;
        }
      }
    }
  }

  lastTouch = touch;
}

// -------- IMAGE --------
void drawImage() {
  display.clearDisplay();
  display.drawBitmap(0, 0, images[currentImage], 128, 64, WHITE);
  display.display();
}


// -------- HEART BITMAP (8x8) --------

// void drawFlight() {
//   static String lastFlight = "";
//   static float lastDistance = -1;
//   static float lastAlt = -1;

//   static float shownDistance = 0;
//   static float shownAlt = 0;

//   static bool anim = false;
//   static unsigned long animStart = 0;
//   static unsigned long lastFrame = 0;

//   // -------- detect new data --------
//   if (flightName != lastFlight || flightDistance != lastDistance) {
//     lastFlight = flightName;
//     lastDistance = flightDistance;

//     shownDistance = 0;
//     shownAlt = 0;

//     anim = true;
//     animStart = millis();
//   }

//   // -------- animation (fast + smooth) --------
//   if (anim) {
//     float p = (millis() - animStart) / 800.0;  // faster feel
//     if (p >= 1.0) { p = 1.0; anim = false; }

//     shownDistance = flightDistance * p;
//     shownAlt = lastAlt * p;
//   }

//   // -------- frame limiter --------
//   if (millis() - lastFrame < 40) return;
//   lastFrame = millis();

//   display.clearDisplay();

//   // ================= TOP: CALLSIGN =================
//   display.setTextSize(2);
//   display.setTextColor(SH110X_WHITE);

//   String name = flightName;
//   name.trim();
//   if (name.length() > 8) name = name.substring(0, 8);

//   int x1 = (128 - name.length() * 12) / 2;
//   display.setCursor(x1, 0);
//   display.print(name);

//   // ================= MIDDLE: DISTANCE =================
//   display.setTextSize(2);

//   String distStr = String((int)shownDistance);

//   String fullText = distStr + " km away";

//   // approximate character width for size 2 font ≈ 12 px per char
//   int textWidth = fullText.length() * 12;

//   int distX = (128 - textWidth) / 2;

//   display.setCursor(distX, 25);
//   display.print(fullText);

//   // ================= BOTTOM: ALTITUDE =================
//   float alt_m = 0;
//   float alt_ft = 0;

//   // get altitude from latest flight data if available
//   // (you must store it in fetchFlightData)
//   alt_m = flightAlt;  
//   alt_ft = alt_m * 3.28084;

//   String altText = String((int)alt_ft) + " ft";

//   int alttextWidth = altText.length() * 12;
//   int x = (128 - alttextWidth) / 2;

//   display.setCursor(x, 45);
//   display.print(altText);

//   display.display();
// }

void drawFlight() {
  static String        lastFlight   = "";
  static float         lastDistance = -1;
  static float         shownDistance = 0;
  static float         shownAlt      = 0;
  static bool          anim          = false;
  static unsigned long animStart     = 0;
  static unsigned long lastFrame     = 0;

  // -------- detect new data --------
  if (flightName != lastFlight || flightDistance != lastDistance) {
    lastFlight    = flightName;
    lastDistance  = flightDistance;
    shownDistance = 0;
    shownAlt      = 0;
    anim          = true;
    animStart     = millis();
  }

  // -------- odometer animation --------
  if (anim) {
    float p = (millis() - animStart) / 800.0;
    if (p >= 1.0) { p = 1.0; anim = false; }
    shownDistance = flightDistance * p;
    shownAlt      = flightAlt * p;
  }

  // -------- frame limiter --------
  if (millis() - lastFrame < 40) return;
  lastFrame = millis();

  bool dotOn = (millis() / 700) % 2 == 0;

  display.clearDisplay();

  // ====== TOP: CALLSIGN + FLIGHT INDEX ======
  String name = flightName;
  name.trim();
  if (name.length() > 6) name = name.substring(0, 6);


  display.setTextSize(2);
  display.setTextColor(SH110X_WHITE);

  int nameW      = name.length() * 12;
  int totalW     = nameW + 10;
  int startX     = (128 - totalW) / 2;

  display.setCursor(startX, 0);
  display.print(name);
  display.setCursor(startX + nameW + 10, 0);

  // ====== MIDDLE: DISTANCE ======
  display.setTextSize(2);
  String fullText = String((int)shownDistance) + " km away";
  int distX = (128 - (int)fullText.length() * 12) / 2;
  display.setCursor(distX, 24);
  display.print(fullText);

  // ====== BOTTOM: ALTITUDE ======
  float alt_ft = flightAlt * 3.28084;
  String altText = String((int)(anim ? shownAlt * 3.28084 : alt_ft)) + " ft";
  int altX = (128 - (int)altText.length() * 12) / 2;
  display.setCursor(altX, 46);
  display.print(altText);

  display.display();
}

// -------- FETCH --------
// void fetchFlight() {
//   if (!wifiConnected || WiFi.status() != WL_CONNECTED) {
//     Serial.println("❌ WiFi not connected");
//     return;
//   }

//   HTTPClient http;
//   String url = "https://opensky-network.org/api/states/all?lamin=12.7&lomin=77.4&lamax=13.2&lomax=77.9";

//   Serial.println("\n🌐 Fetching flight data...");
//   http.begin(url);

//   int code = http.GET();

//   if (code != 200) {
//     Serial.print("❌ HTTP Error: ");
//     Serial.println(code);
//     http.end();
//     return;
//   }

//   // 👉 Use full string instead of stream (more reliable for debugging)
//   String payload = http.getString();

//   Serial.println("📦 Payload received (first 300 chars):");
//   Serial.println(payload.substring(0, 300));

//   // 👉 Slightly larger buffer for safety
//   DynamicJsonDocument doc(8192);

//   DeserializationError error = deserializeJson(doc, payload);

//   if (error) {
//     Serial.print("❌ JSON Error: ");
//     Serial.println(error.c_str());
//     http.end();
//     return;
//   }

//   JsonArray states = doc["states"];

//   if (states.isNull() || states.size() == 0) {
//     Serial.println("❌ No flights found");
//     http.end();
//     return;
//   }

//   // ✅ Take FIRST flight
//   JsonArray f = states[0];

//   Serial.println("\n Raw first flight data:");
//   serializeJsonPretty(f, Serial);
//   Serial.println();

//   // ✅ Validate required fields
//   if (f[5].isNull() || f[6].isNull()) {
//     Serial.println("❌ Invalid lat/lon");
//     http.end();
//     return;
//   }

//   float lon = f[5];
//   float lat = f[6];
//   float alt = f[7].isNull() ? 0 : f[7];

//   flightAlt = alt;

//   // ✅ Callsign handling
//   String callsign = "N/A";
//   if (!f[1].isNull()) {
//     callsign = String((const char*)f[1]);
//     callsign.trim();
//     if (callsign.length() == 0) callsign = "N/A";
//   }

//   // ✅ Distance calculation
//   float dist = getDistance(userLat, userLon, lat, lon);

//   // ✅ Store results
//   flightName = callsign;
//   flightDistance = dist;

//   // ✅ Clean debug output
//   Serial.println("\n✅ PROCESSED DATA:");
//   Serial.print("Flight: "); Serial.println(flightName);
//   Serial.print("Lat: "); Serial.println(lat, 6);
//   Serial.print("Lon: "); Serial.println(lon, 6);
//   Serial.print("Alt: "); Serial.println(alt);
//   Serial.print("Distance: "); Serial.println(flightDistance);

//   http.end();
// }

void fetchFlight() {
  if (!wifiConnected || WiFi.status() != WL_CONNECTED) {
    Serial.println("❌ WiFi not connected");
    return;
  }

  HTTPClient http;
  String url = "https://opensky-network.org/api/states/all?lamin=12.7&lomin=77.4&lamax=13.2&lomax=77.9";

  Serial.println("\n🌐 Fetching flight data...");
  http.begin(url);

  int code = http.GET();
  if (code != 200) {
    Serial.print("❌ HTTP Error: ");
    Serial.println(code);
    http.end();
    return;
  }

  String payload = http.getString();
  Serial.println("📦 Payload (first 300 chars):");
  Serial.println(payload.substring(0, 300));

  DynamicJsonDocument doc(8192);
  DeserializationError error = deserializeJson(doc, payload);
  if (error) {
    Serial.print("❌ JSON Error: ");
    Serial.println(error.c_str());
    http.end();
    return;
  }

  JsonArray states = doc["states"];
  if (states.isNull() || states.size() == 0) {
    Serial.println("❌ No flights found");
    http.end();
    return;
  }

  // -------- grab top 3 valid flights --------
  flightCount   = 0;
  currentFlight = 0;

  for (int i = 0; i < (int)states.size() && flightCount < 3; i++) {
    JsonArray f = states[i];

    if (f[5].isNull() || f[6].isNull()) continue;  // skip only if no position

    float lon = f[5];
    float lat = f[6];
    float alt = f[7].isNull() ? 0 : f[7];

    String callsign = "UNKNOWN";  // default instead of skipping
    if (!f[1].isNull()) {
      callsign = String((const char*)f[1]);
      callsign.trim();
      if (callsign.length() == 0) callsign = "UNKNWN";  // blank callsign fallback
    }

    flights[flightCount].name     = callsign;
    flights[flightCount].distance = getDistance(userLat, userLon, lat, lon);
    flights[flightCount].alt      = alt;

    Serial.print("Stored flight "); Serial.print(flightCount + 1);
    Serial.print(": "); Serial.println(callsign);

    flightCount++;
  }

  Serial.print("Total flights stored: ");
  Serial.println(flightCount);

  // -------- load first flight into display vars --------
  if (flightCount > 0) {
    flightName     = flights[0].name;
    flightDistance = flights[0].distance;
    flightAlt      = flights[0].alt;

    Serial.println("\n✅ FLIGHTS FETCHED:");
    for (int i = 0; i < flightCount; i++) {
      Serial.print(i + 1); Serial.print(". ");
      Serial.print(flights[i].name);
      Serial.print("  dist: "); Serial.print(flights[i].distance);
      Serial.print("  alt: ");  Serial.println(flights[i].alt);
    }
  }

  http.end();
}